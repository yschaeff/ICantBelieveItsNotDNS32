## main/Kconfig.projbuild
```kconfig
menu "DNS Configuration"

config BLINK_GPIO
    int "Blink GPIO number"
	range 0 34
	default 5
	help
		GPIO number (IOxx) to blink on and off.
		Some GPIOs are used for other purposes (flash connections, etc.) and cannot be used to blink.
		GPIOs 35-39 are input-only so cannot be used as outputs.

config DNS_SERVER_PORT
    int "UDP/TCP listening port"
    range 1 65635
    default 53
    help
        UDP/TCP port on which the DNS server will answer queries.

config DNS_SERVER_AXFR_MASTER
    string "AXFR host"
    default "ns1.example.com"
    help
        FQDN or ip address of host that provided
        the AXFR.

config DNS_SERVER_AXFR_PORT
    int "TCP AXFR port"
    range 1 65635
    default 53
    help
        TCP destination port for requesting AXFR.

config DNS_SERVER_AXFR_ZONE
    string "Zone to ask AXFR for"
    default "example.com"
    help
        Zone to transfer

endmenu

menu "WiFi access point configuration"

config WIFI_AP1
    bool "Set access point 1"
config WIFI_AP1_SSID
    string "SSID of access point 1" if WIFI_AP1
config WIFI_AP1_PASSWORD
    string "Password of access point 1" if WIFI_AP1

config WIFI_AP2
    bool "Set access point 2" if WIFI_AP1
config WIFI_AP2_SSID
    string "SSID of access point 1" if WIFI_AP2
config WIFI_AP2_PASSWORD
    string "Password of access point 1" if WIFI_AP2


config WIFI_AP3
    bool "Set access point 3" if WIFI_AP2
config WIFI_AP3_SSID
    string "SSID of access point 1" if WIFI_AP3
config WIFI_AP3_PASSWORD
    string "Password of access point 1" if WIFI_AP3


config WIFI_AP4
    bool "Set access point 4" if WIFI_AP3
config WIFI_AP4_SSID
    string "SSID of access point 1" if WIFI_AP4
config WIFI_AP4_PASSWORD
    string "Password of access point 1" if WIFI_AP4


config WIFI_AP5
    bool "Set access point 5" if WIFI_AP4
config WIFI_AP5_SSID
    string "SSID of access point 1" if WIFI_AP5
config WIFI_AP5_PASSWORD
    string "Password of access point 1" if WIFI_AP5

config WIFI_AP_COUNT
    int "Number of access points configured"
    range 0 5
    default 5 if WIFI_AP5
    default 4 if WIFI_AP4
    default 3 if WIFI_AP3
    default 2 if WIFI_AP2
    default 1 if WIFI_AP1
    default 0

endmenu
```
